## config/west.yml
```yaml
manifest:
  remotes:
    - name: zmkfirmware
      url-base: https://github.com/zmkfirmware
    - name: petejohanson
      url-base: https://github.com/petejohanson
    - name: urob
      url-base: https://github.com/urob
  projects:
    # - name: zmk
    #   remote: petejohanson
    #   revision: feat/pointers-move-scroll
    #   import: app/west.yml
    - name: zmk
      remote: urob
      revision: main
      import: app/west.yml
  self:
    path: config
```
